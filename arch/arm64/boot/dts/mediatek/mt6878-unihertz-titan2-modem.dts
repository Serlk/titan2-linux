// SPDX-License-Identifier: (GPL-2.0-only OR MIT)
/*
 * Titan 2, modem bring-up: the CCCI driver bound, with the MD power
 * domain, so that the modem can be restarted the stock way on request.
 *
 * Copyright (c) 2026 serlk <22211586+Serlk@users.noreply.github.com>
 *
 * On top of the power-domain stage. Nothing here switches the modem by
 * itself: the MD domain is registered default-off (genpd never touches
 * the modem LK started), the driver only adds itself to it, and the
 * modem is switched only by an explicit debugfs command with the module
 * parameter mtk_ccci.power_ctrl=1.
 */

#include "mt6878-unihertz-titan2-pd.dts"
#include "mt6878-unihertz-titan2-modem.dtsi"
