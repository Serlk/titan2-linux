// SPDX-License-Identifier: (GPL-2.0-only OR MIT)
/*
 * Titan 2, connectivity bring-up: CONNINFRA (CONNSYS power and bus).
 *
 * On top of the power-domain stage, as the CONN domain comes from SPM.
 * Not built into the default image.
 *
 * The stock LK looks for /soc/consys (then /consys) in our DTB when it
 * loads the CONNSYS firmware. With this node present it reads the hwid-node GPIOs,
 * rewrites "compatible" with the A-die it finds (MT6637 on this board, as
 * in the stock DT) and programs the PMIF for that A-die, as it does under
 * Android.
 *
 * With /consys, /gps and /wifi all present LK also loads the CONNSYS
 * firmware: it takes the EMI sizes from these nodes
 * (stock values below), carves the CONNSYS EMI, the GNSS EMI, the WFDMA
 * pool and the CONNSYS<->SCP window out of DRAM below 0x90000000 (they
 * show up in /reserved-memory as consys_emi_reserved,
 * shared-dma-pool_wifi-reserve-memory and consys_scp_emi_reserved), writes
 * "emi-addr" into /consys and /gps and "memory-region" into /wifi, copies
 * the BT, GNSS and Wi-Fi ROM images from the connsys_* partitions into
 * the read-only part of the CONNSYS EMI, sets the EMI MPU and tells ATF
 * the addresses. A zero or missing size makes LK skip all of that; a size
 * that does not fit makes mblock panic, so keep the stock values
 * (scripts/lk-fdt-check.py checks them).
 */

#include "mt6878-unihertz-titan2-pd.dts"
#include "mt6878-unihertz-titan2-wifi.dtsi"
