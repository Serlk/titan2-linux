// SPDX-License-Identifier: (GPL-2.0-only OR MIT)
/*
 * Titan 2: the modem bring-up, applied by mt6878-unihertz-titan2-modem.dts and
 * mt6878-unihertz-titan2-all*.dts.
 *
 * Copyright (c) 2026 serlk <22211586+Serlk@users.noreply.github.com>
 */

&spm {
	power-domain@MT6878_POWER_DOMAIN_MD {
		reg = <MT6878_POWER_DOMAIN_MD>;
		#power-domain-cells = <0>;
	};
};

&modem {
	/* not "power-domains": see the binding */
	mediatek,modem-power-domain = <&spm MT6878_POWER_DOMAIN_MD>;

	/*
	 * Pins the modem asks for over RPC (downstream "gpio_usage_mapping"):
	 * SIM hot plug and interface, band detection. The modem numbers
	 * them as &pio does.
	 */
	mediatek,md-gpio-names = "GPIO_SIM1_HOT_PLUG", "GPIO_SIM2_HOT_PLUG",
				 "GPIO_SIM1_SCLK", "GPIO_SIM1_SRST",
				 "GPIO_SIM1_SIO", "GPIO_SIM2_SCLK",
				 "GPIO_SIM2_SRST", "GPIO_SIM2_SIO",
				 "GPIO_FDD_Band_Support_Detection_1",
				 "GPIO_FDD_Band_Support_Detection_2";
	mediatek,md-gpios = <&pio 46 GPIO_ACTIVE_HIGH>, <&pio 47 GPIO_ACTIVE_HIGH>,
			    <&pio 83 GPIO_ACTIVE_HIGH>, <&pio 84 GPIO_ACTIVE_HIGH>,
			    <&pio 85 GPIO_ACTIVE_HIGH>, <&pio 86 GPIO_ACTIVE_HIGH>,
			    <&pio 87 GPIO_ACTIVE_HIGH>, <&pio 88 GPIO_ACTIVE_HIGH>,
			    <&pio 186 GPIO_ACTIVE_HIGH>, <&pio 187 GPIO_ACTIVE_HIGH>;

	/*
	 * The board ADC the modem reads at boot: MT6363 AUXADC VIN1 without
	 * pull-up, channel number 19 as the downstream driver reports it. The
	 * mainline AUXADC driver reads VIN1 with the 100k pull-up only, so
	 * the value is the one the factory firmware read on this board (raw
	 * 1833..1921 over four boots, ~105 mV).
	 */
	mediatek,md-adc = <19 1860>;
	/*
	 * SIM hot plug interrupts as the modem sees them, from the factory
	 * MD1-SIM<n>-HOT-PLUG-EINT nodes: modem EINT 0/1, 10 ms debounce,
	 * level low, socket type 0, not dedicated, source pin 1/2.
	 */
	mediatek,md-sim-eints = <0 10 0 0 0 0 1>,
				<1 10 0 0 0 0 2>;
	status = "okay";
};
