// SPDX-License-Identifier: (GPL-2.0-only OR MIT)
/*
 * Titan 2: the dvfs bring-up, applied by mt6878-unihertz-titan2-dvfs.dts and
 * mt6878-unihertz-titan2-all*.dts.
 *
 * Copyright (c) 2026 serlk <22211586+Serlk@users.noreply.github.com>
 */

&performance {
	status = "okay";
};

&lvts_ap {
	status = "okay";
};

&lvts_mcu {
	status = "okay";
};
