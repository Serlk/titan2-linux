// SPDX-License-Identifier: (GPL-2.0-only OR MIT)
/*
 * Titan 2, display bring-up: mediatek-drm on the main panel instead of
 * simplefb and the LK frame trigger.
 *
 * Copyright (c) 2026 serlk <22211586+Serlk@users.noreply.github.com>
 *
 * Handover from LK: the DSI PHY keeps the PLL LK left running, DSI0 keeps
 * LK's D-PHY timings and lane state, the panel driver takes the panel over
 * without a reset, and frames go through the pipeline LK programmed
 * (OVL0_2L ... DSI0, mutex 0). Until mediatek-drm has bound and sent its
 * first frame, nothing on the display path is written: if it never binds,
 * the panel keeps LK's picture from its own frame memory.
 *
 * Builds on the -pd variant (power controller on). The panel power
 * switches are plain GPIOs: always on here, so that the panel stays lit
 * whether or not its driver ever probes; display off is DCS sleep in.
 */

#include "mt6878-unihertz-titan2-pd.dts"
#include "mt6878-unihertz-titan2-drm.dtsi"
