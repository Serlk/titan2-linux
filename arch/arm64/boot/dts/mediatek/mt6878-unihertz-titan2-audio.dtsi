// SPDX-License-Identifier: (GPL-2.0-only OR MIT)
/*
 * Titan 2: the audio bring-up, applied by mt6878-unihertz-titan2-audio.dts and
 * mt6878-unihertz-titan2-all*.dts.
 *
 * Copyright (c) 2026 serlk <22211586+Serlk@users.noreply.github.com>
 */

&afe {
	status = "okay";
};

&mt6369_codec {
	status = "okay";
};

&speaker_amp {
	status = "okay";
};

&sound {
	status = "okay";
};
