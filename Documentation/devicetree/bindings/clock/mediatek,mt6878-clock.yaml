## drivers/soc/mediatek/Kconfig
```kconfig
# SPDX-License-Identifier: GPL-2.0-only
#
# MediaTek SoC drivers
#
menu "MediaTek SoC drivers"
	depends on ARCH_MEDIATEK || COMPILE_TEST

config MTK_CMDQ
	tristate "MediaTek CMDQ Support"
	depends on ARCH_MEDIATEK || COMPILE_TEST
	select MAILBOX
	select MTK_CMDQ_MBOX
	select MTK_INFRACFG
	help
	  Say yes here to add support for the MediaTek Command Queue (CMDQ)
	  driver. The CMDQ is used to help read/write registers with critical
	  time limitation, such as updating display configuration during the
	  vblank.

config MTK_CONNINFRA
	tristate "MediaTek CONNINFRA (connectivity subsystem) support"
	depends on ARCH_MEDIATEK || COMPILE_TEST
	depends on OF && PM && HAVE_ARM_SMCCC
	select MFD_SYSCON
	select REGMAP
	help
	  Say yes here to add support for CONNINFRA, the power and bus
	  infrastructure of the MediaTek connectivity subsystem (CONNSYS)
	  found on smartphone SoCs such as the MT6878. It switches the
	  subsystem on and is shared by the Wi-Fi, Bluetooth, GNSS and FM
	  drivers.

config MTK_LPM
	tristate "MediaTek MT6878 low power manager (suspend-to-idle)"
	depends on ARCH_MEDIATEK || COMPILE_TEST
	depends on OF && CPU_IDLE && SUSPEND && HAVE_ARM_SMCCC
	select MFD_SYSCON
	select REGMAP
	help
	  Say yes here for the kernel side of the system low power handshake
	  with the trusted firmware and the SPM on the MediaTek MT6878: the
	  CPU suspend source around suspend-to-idle, the wake-up interrupt,
	  the interrupts kept through MCUSYS off, the SPM constraints, and
	  the report of what woke the system and how deep it slept.

config MTK_DEVAPC
	tristate "Mediatek Device APC Support"
	help
	  Say yes here to enable support for Mediatek Device APC driver.
	  This driver is mainly used to handle the violation which catches
	  unexpected transaction.
	  The violation information is logged for further analysis or
	  countermeasures.

config MTK_DVFSRC
	tristate "MediaTek DVFSRC Support"
	depends on ARCH_MEDIATEK
	help
	  Say yes here to add support for the MediaTek Dynamic Voltage
	  and Frequency Scaling Resource Collector (DVFSRC): a HW
	  IP found on many MediaTek SoCs, which is responsible for
	  collecting DVFS requests from various SoC IPs, other than
	  software, and performing bandwidth scaling to provide the
	  best achievable performance-per-watt.

config MTK_INFRACFG
	bool "MediaTek INFRACFG Support"
	select REGMAP
	help
	  Say yes here to add support for the MediaTek INFRACFG controller. The
	  INFRACFG controller contains various infrastructure registers not
	  directly associated to any device.

config MTK_PMIC_WRAP
	tristate "MediaTek PMIC Wrapper Support"
	depends on RESET_CONTROLLER
	depends on OF
	select REGMAP
	help
	  Say yes here to add support for MediaTek PMIC Wrapper found
	  on different MediaTek SoCs. The PMIC wrapper is a proprietary
	  hardware to connect the PMIC.

config MTK_REGULATOR_COUPLER
	bool "MediaTek SoC Regulator Coupler" if COMPILE_TEST
	default ARCH_MEDIATEK
	depends on REGULATOR

config MTK_MMSYS
	tristate "MediaTek MMSYS Support"
	default ARCH_MEDIATEK
	depends on HAS_IOMEM
	depends on MTK_CMDQ || MTK_CMDQ=n
	help
	  Say yes here to add support for the MediaTek Multimedia
	  Subsystem (MMSYS).

config MTK_SVS
	tristate "MediaTek Smart Voltage Scaling(SVS)"
	depends on NVMEM_MTK_EFUSE && NVMEM
	help
	  The Smart Voltage Scaling(SVS) engine is a piece of hardware
	  which has several controllers(banks) for calculating suitable
	  voltage to different power domains(CPU/GPU/CCI) according to
	  chip process corner, temperatures and other factors. Then DVFS
	  driver could apply SVS bank voltage to PMIC/Buck.

config MTK_SOCINFO
	tristate "MediaTek SoC Information"
	default y
	depends on NVMEM_MTK_EFUSE
	select SOC_BUS
	help
	  The MediaTek SoC Information (mtk-socinfo) driver provides
	  information about the SoC to the userspace including the
	  manufacturer name, marketing name and soc name.

config MTK_MBOX
	tristate "MediaTek tinysys mailbox"
	depends on ARCH_MEDIATEK || COMPILE_TEST
	depends on OF
	help
	  The MediaTek tinysys mailbox used by the downstream MT6878 kernel to talk
	  to the SCP: per mailbox a block of SRAM slots and set/clear
	  interrupt registers. Ported from the MediaTek GPL device-modules
	  tree (kernel_device_modules-6.1).

config MTK_TINYSYS_IPI
	tristate "MediaTek tinysys IPI"
	depends on RPMSG_MTK_MBOX
	help
	  The downstream MediaTek IPI layer on top of the tinysys mailbox (through
	  rpmsg): numbered channels with send, receive and send-and-wait for
	  the SCP. Ported from the MediaTek GPL device-modules tree
	  (kernel_device_modules-6.1).

source "drivers/soc/mediatek/scp/Kconfig"
source "drivers/soc/mediatek/sensorhub/Kconfig"

endmenu
```
