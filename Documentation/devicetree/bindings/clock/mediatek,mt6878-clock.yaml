## Documentation/devicetree/bindings/sound/mediatek,mt6878-afe.yaml
```yaml
# SPDX-License-Identifier: (GPL-2.0-only OR BSD-2-Clause)
%YAML 1.2
---
$id: http://devicetree.org/schemas/sound/mediatek,mt6878-afe.yaml#
$schema: http://devicetree.org/meta-schemas/core.yaml#

title: MediaTek Audio Front End PCM controller for MT6878

maintainers:
  - Serlk <22211586+Serlk@users.noreply.github.com>

description:
  The Audio Front End (AFE) of the MT6878 SoC moves audio between memory
  and the audio interfaces (ADDA to the PMIC codec, I2S/ETDM, PCM, TDM).
  The AFE gates its own module clocks through its register space; the
  clocks below come from topckgen and pericfg_ao.

properties:
  compatible:
    const: mediatek,mt6878-afe

  reg:
    maxItems: 1

  interrupts:
    maxItems: 1

  memory-region:
    maxItems: 1

  power-domains:
    maxItems: 1

  clocks:
    items:
      - description: mux for the audio internal bus
      - description: mux selecting APLL1 for the audio clock tree
      - description: mux selecting APLL2 for the audio clock tree
      - description: mux for the audio engine, 44.1 kHz family
      - description: mux for the audio engine, 48 kHz family
      - description: mux for the audio high speed clock
      - description: APLL1 output
      - description: APLL2 output
      - description: APLL1 divided by 4
      - description: APLL2 divided by 4
      - description: 26 MHz reference
      - description: pericfg_ao audio slave bus gate
      - description: pericfg_ao audio master bus gate
      - description: pericfg_ao audio internal bus gate

  clock-names:
    items:
      - const: top_aud_intbus
      - const: top_aud_1
      - const: top_aud_2
      - const: top_aud_eng1
      - const: top_aud_eng2
      - const: top_aud_h
      - const: apll1
      - const: apll2
      - const: apll1_d4
      - const: apll2_d4
      - const: clk26m
      - const: peri_aud_slv
      - const: peri_aud_mst
      - const: peri_aud_intbus

  mediatek,topckgen:
    $ref: /schemas/types.yaml#/definitions/phandle
    description:
      The topckgen syscon. Its audio test registers are used to calibrate
      the phase of the MTKAIF data lines to the PMIC codec.

  pinctrl-names:
    const: default

  pinctrl-0:
    description:
      The MTKAIF and I2S pins the board uses, in their audio function.

required:
  - compatible
  - reg
  - interrupts
  - power-domains
  - clocks
  - clock-names

additionalProperties: false

examples:
  - |
    #include <dt-bindings/clock/mediatek,mt6878-clock.h>
    #include <dt-bindings/interrupt-controller/arm-gic.h>
    #include <dt-bindings/interrupt-controller/irq.h>
    #include <dt-bindings/power/mediatek,mt6878-power.h>

    soc {
        #address-cells = <2>;
        #size-cells = <2>;

        afe@11050000 {
            compatible = "mediatek,mt6878-afe";
            reg = <0 0x11050000 0 0x9000>;
            interrupts = <GIC_SPI 392 IRQ_TYPE_LEVEL_HIGH 0>;
            power-domains = <&spm MT6878_POWER_DOMAIN_AUDIO>;
            clocks = <&topckgen CLK_TOP_AUD_INTBUS_SEL>,
                     <&topckgen CLK_TOP_AUD_1_SEL>,
                     <&topckgen CLK_TOP_AUD_2_SEL>,
                     <&topckgen CLK_TOP_AUD_ENGEN1_SEL>,
                     <&topckgen CLK_TOP_AUD_ENGEN2_SEL>,
                     <&topckgen CLK_TOP_AUDIO_H_SEL>,
                     <&topckgen CLK_TOP_APLL1>,
                     <&topckgen CLK_TOP_APLL2>,
                     <&topckgen CLK_TOP_APLL1_D4>,
                     <&topckgen CLK_TOP_APLL2_D4>,
                     <&topckgen CLK_TOP_TCK_26M_MX9>,
                     <&pericfg_ao CLK_PERAOP_AUDIO0>,
                     <&pericfg_ao CLK_PERAOP_AUDIO1>,
                     <&pericfg_ao CLK_PERAOP_AUDIO2>;
            clock-names = "top_aud_intbus",
                          "top_aud_1",
                          "top_aud_2",
                          "top_aud_eng1",
                          "top_aud_eng2",
                          "top_aud_h",
                          "apll1",
                          "apll2",
                          "apll1_d4",
                          "apll2_d4",
                          "clk26m",
                          "peri_aud_slv",
                          "peri_aud_mst",
                          "peri_aud_intbus";
        };
    };

...
```

## Documentation/devicetree/bindings/sound/unihertz,titan2-sound.yaml
```yaml
# SPDX-License-Identifier: (GPL-2.0-only OR BSD-2-Clause)
%YAML 1.2
---
$id: http://devicetree.org/schemas/sound/unihertz,titan2-sound.yaml#
$schema: http://devicetree.org/meta-schemas/core.yaml#

title: Unihertz Titan 2 sound card

maintainers:
  - serlk <22211586+Serlk@users.noreply.github.com>

description:
  MT6878 audio front end with the MT6369 PMIC codec on the ADDA link
  (receiver, headset over USB-C, microphones) and a FourSemi FS199x
  amplifier on I2SOUT4 for the loudspeaker.

allOf:
  - $ref: sound-card-common.yaml#

properties:
  compatible:
    const: unihertz,titan2-sound

  audio-routing:
    description:
      Valid names are the input and output widgets of the codecs and the
      card widgets "Speaker", "Earpiece", "Headphones", "Main Mic",
      "Second Mic" and "Headset Mic".

  mediatek,platform:
    $ref: /schemas/types.yaml#/definitions/phandle
    description: The phandle of the MT6878 AFE.

patternProperties:
  "^dai-link-[0-9]+$":
    type: object
    description:
      Container for dai-link level properties and CODEC sub-nodes.

    properties:
      link-name:
        description: Name of the BE dai-link the node applies to.
        enum:
          - ADDA_BE
          - I2SOUT4_BE
          - I2SIN4_BE

      codec:
        description: Holds subnode which indicates codec dai.
        type: object
        additionalProperties: false
        properties:
          sound-dai:
            minItems: 1
            maxItems: 2
        required:
          - sound-dai

      dai-format:
        description: audio format.
        enum:
          - i2s
          - right_j
          - left_j
          - dsp_a
          - dsp_b

      mediatek,clk-provider:
        $ref: /schemas/types.yaml#/definitions/string
        description: Indicates dai-link clock master.
        enum:
          - cpu
          - codec

    additionalProperties: false

    required:
      - link-name

required:
  - compatible
  - audio-routing
  - mediatek,platform

unevaluatedProperties: false

examples:
  - |
    sound {
        compatible = "unihertz,titan2-sound";
        model = "Titan2";
        mediatek,platform = <&afe>;
        audio-routing =
            "Headphones", "Headphone L",
            "Headphones", "Headphone R",
            "Earpiece", "Receiver",
            "Speaker", "SPK",
            "AIN0", "Main Mic",
            "AIN1", "Headset Mic",
            "AIN2", "Second Mic";

        dai-link-0 {
            link-name = "ADDA_BE";
            codec {
                sound-dai = <&mt6369_codec>;
            };
        };

        dai-link-1 {
            link-name = "I2SOUT4_BE";
            dai-format = "i2s";
            mediatek,clk-provider = "cpu";
            codec {
                sound-dai = <&speaker_amp>;
            };
        };
    };

...
```

## Documentation/devicetree/bindings/spmi/mtk,spmi-mtk-pmif.yaml
```yaml
# SPDX-License-Identifier: (GPL-2.0 OR BSD-2-Clause)
%YAML 1.2
---
$id: http://devicetree.org/schemas/spmi/mtk,spmi-mtk-pmif.yaml#
$schema: http://devicetree.org/meta-schemas/core.yaml#

title: Mediatek SPMI Controller

maintainers:
  - Hsin-Hsiung Wang <hsin-hsiung.wang@mediatek.com>

description: |+
  On MediaTek SoCs the PMIC is connected via SPMI and the controller allows
  for multiple SoCs to control a single SPMI master.

  The SPMI 2.0 variants also act as an interrupt controller for the Request
  Capable Slave (RCS) interrupts raised by the devices on the bus.

allOf:
  - $ref: spmi.yaml
  - if:
      properties:
        compatible:
          contains:
            const: mediatek,mt6878-spmi
    then:
      properties:
        clocks: false
        clock-names: false
        assigned-clocks: false
        assigned-clock-parents: false
      required:
        - interrupts
        - interrupt-names
        - interrupt-controller
        - "#interrupt-cells"
    else:
      properties:
        interrupts: false
        interrupt-names: false
        interrupt-controller: false
        "#interrupt-cells": false
      required:
        - clocks
        - clock-names

properties:
  compatible:
    oneOf:
      - enum:
          - mediatek,mt6873-spmi
          - mediatek,mt6878-spmi
          - mediatek,mt8195-spmi
      - items:
          - enum:
              - mediatek,mt8186-spmi
              - mediatek,mt8188-spmi
              - mediatek,mt8189-spmi
          - const: mediatek,mt8195-spmi

  reg:
    maxItems: 2

  reg-names:
    items:
      - const: pmif
      - const: spmimst

  clocks:
    minItems: 3
    maxItems: 3

  clock-names:
    items:
      - const: pmif_sys_ck
      - const: pmif_tmr_ck
      - const: spmimst_clk_mux

  assigned-clocks:
    maxItems: 1

  assigned-clock-parents:
    maxItems: 1

  interrupts:
    maxItems: 1

  interrupt-names:
    const: rcs

  interrupt-controller: true

  "#interrupt-cells":
    const: 3
    description: |
      cell 1: slave ID for the requested interrupt (0-15)
      cell 2: the requested peripheral interrupt (0-7)
      cell 3: interrupt flags indicating level-sense information,
              as defined in dt-bindings/interrupt-controller/irq.h

required:
  - compatible
  - reg
  - reg-names

unevaluatedProperties: false

examples:
  - |
    #include <dt-bindings/clock/mt8192-clk.h>

    spmi: spmi@10027000 {
        compatible = "mediatek,mt6873-spmi";
        reg = <0x10027000 0xe00>,
              <0x10029000 0x100>;
        reg-names = "pmif", "spmimst";
        clocks = <&infracfg CLK_INFRA_PMIC_AP>,
                 <&infracfg CLK_INFRA_PMIC_TMR>,
                 <&topckgen CLK_TOP_SPMI_MST_SEL>;
        clock-names = "pmif_sys_ck",
                      "pmif_tmr_ck",
                      "spmimst_clk_mux";
        assigned-clocks = <&topckgen CLK_TOP_PWRAP_ULPOSC_SEL>;
        assigned-clock-parents = <&topckgen CLK_TOP_OSC_D10>;
    };

  - |
    #include <dt-bindings/interrupt-controller/irq.h>

    spmi@1cc04000 {
        compatible = "mediatek,mt6878-spmi";
        reg = <0x1cc04000 0x900>,
              <0x1cc01000 0x100>;
        reg-names = "pmif", "spmimst";
        interrupts-extended = <&pio 212 IRQ_TYPE_LEVEL_HIGH>;
        interrupt-names = "rcs";
        interrupt-controller;
        #interrupt-cells = <3>;
        #address-cells = <2>;
        #size-cells = <0>;
    };
...
```

## drivers/gpu/drm/sysfb/Kconfig
```kconfig
# SPDX-License-Identifier: GPL-2.0-only

menu "Drivers for system framebuffers"
	depends on DRM

config DRM_SYSFB_HELPER
	tristate
	depends on DRM

config DRM_COREBOOTDRM
	tristate "Coreboot framebuffer driver"
	depends on DRM && MMU
	depends on GOOGLE_FRAMEBUFFER_COREBOOT
	select APERTURE_HELPERS
	select DRM_CLIENT_SELECTION
	select DRM_GEM_SHMEM_HELPER
	select DRM_KMS_HELPER
	select DRM_SYSFB_HELPER
	help
	  DRM driver for coreboot-provided framebuffers.

	  This driver assumes that the display hardware has been initialized
	  by coreboot firmware before the kernel boots. Scanout buffer, size,
	  and display format must be provided via coreboot framebuffer device.

config DRM_EFIDRM
	tristate "EFI framebuffer driver"
	depends on DRM && MMU && EFI && (!SYSFB_SIMPLEFB || COMPILE_TEST)
	select APERTURE_HELPERS
	select DRM_CLIENT_SELECTION
	select DRM_GEM_SHMEM_HELPER
	select DRM_KMS_HELPER
	select DRM_SYSFB_HELPER
	select SYSFB
	help
	  DRM driver for EFI framebuffers.

	  This driver assumes that the display hardware has been initialized
	  by the firmware or bootloader before the kernel boots. Scanout
	  buffer, size, and display format must be provided via EFI interfaces.

config DRM_OFDRM
	tristate "Open Firmware display driver"
	depends on DRM && MMU && OF && (PPC || COMPILE_TEST)
	select APERTURE_HELPERS
	select DRM_CLIENT_SELECTION
	select DRM_GEM_SHMEM_HELPER
	select DRM_KMS_HELPER
	select DRM_SYSFB_HELPER
	help
	  DRM driver for Open Firmware framebuffers.

	  This driver assumes that the display hardware has been initialized
	  by the Open Firmware before the kernel boots. Scanout buffer, size,
	  and display format must be provided via device tree.

config DRM_SIMPLEDRM
	tristate "Simple framebuffer driver"
	depends on DRM && MMU
	select APERTURE_HELPERS
	select DRM_CLIENT_SELECTION
	select DRM_GEM_SHMEM_HELPER
	select DRM_KMS_HELPER
	select DRM_SYSFB_HELPER
	help
	  DRM driver for simple platform-provided framebuffers.

	  This driver assumes that the display hardware has been initialized
	  by the firmware or bootloader before the kernel boots. Scanout
	  buffer, size, and display format must be provided via device tree,
	  UEFI, VESA, etc.

	  On x86 BIOS or UEFI systems, you should also select SYSFB_SIMPLEFB
	  to use UEFI and VESA framebuffers.

config DRM_MTK_CMDFB_KICK
	tristate "Frame trigger for MediaTek command-mode DSI boot framebuffers"
	depends on DRM_SIMPLEDRM && OF
	depends on ARCH_MEDIATEK || COMPILE_TEST
	depends on BACKLIGHT_CLASS_DEVICE || !BACKLIGHT_CLASS_DEVICE
	help
	  On MediaTek SoCs whose bootloader leaves a DSI panel in command
	  mode, framebuffer writes only reach the panel after a frame has
	  been started. This driver starts one frame after each simpledrm
	  update, reusing the pipeline set up by the bootloader, and turns
	  off bootloader overlay layers. When simpledrm disables its CRTC
	  (DPMS off, fbdev blank), the panel is put to sleep with standard
	  DCS commands and its backlight is switched off. Timings and panel
	  supplies are left as they are.

	  Do not enable together with a full MediaTek DRM driver for the
	  same display.

	  If unsure, say N.

config DRM_VESADRM
	tristate "VESA framebuffer driver"
	depends on DRM && MMU && X86 && (!SYSFB_SIMPLEFB || COMPILE_TEST)
	select APERTURE_HELPERS
	select DRM_CLIENT_SELECTION
	select DRM_GEM_SHMEM_HELPER
	select DRM_KMS_HELPER
	select DRM_SYSFB_HELPER
	select SYSFB
	help
	  DRM driver for VESA framebuffers.

	  This driver assumes that the display hardware has been initialized
	  by the firmware or bootloader before the kernel boots. Scanout
	  buffer, size, and display format must be provided via VBE interfaces.

endmenu
```

## drivers/net/wireless/mediatek/mt76/mt7921/Kconfig
```kconfig
# SPDX-License-Identifier: BSD-3-Clause-Clear
config MT7921_COMMON
	tristate
	select MT792x_LIB
	select WANT_DEV_COREDUMP

config MT7921E
	tristate "MediaTek MT7921E (PCIe) support"
	select MT7921_COMMON
	depends on MAC80211
	depends on PCI
	help
	  This adds support for MT7921E 802.11ax 2x2:2SS wireless devices.

	  To compile this driver as a module, choose M here.

config MT7921S
	tristate "MediaTek MT7921S (SDIO) support"
	select MT76_SDIO
	select MT7921_COMMON
	depends on MAC80211
	depends on MMC
	help
	  This adds support for MT7921S 802.11ax 2x2:2SS wireless devices.

	  To compile this driver as a module, choose M here.

config MT7921U
	tristate "MediaTek MT7921U (USB) support"
	select MT792x_USB
	select MT7921_COMMON
	depends on MAC80211
	depends on USB
	help
	  This adds support for MT7921U 802.11ax 2x2:2SS wireless devices.

	  To compile this driver as a module, choose M here.

config MT7921_SOC
	tristate "MediaTek MT7921 (MT6878 CONNSYS) AXI support"
	select MT7921_COMMON
	depends on MAC80211
	depends on ARCH_MEDIATEK || COMPILE_TEST
	depends on OF
	depends on MTK_CONNINFRA
	help
	  This adds support for the MT7921 Wi-Fi core built into the
	  connectivity subsystem (CONNSYS) of the MediaTek MT6878 SoC,
	  attached over AXI. The firmware is loaded by the boot loader.

	  To compile this driver as a module, choose M here.
```
