## Documentation/devicetree/bindings/mfd/mediatek,mt6363.yaml
```yaml
# SPDX-License-Identifier: (GPL-2.0-only OR BSD-2-Clause)
%YAML 1.2
---
$id: http://devicetree.org/schemas/mfd/mediatek,mt6363.yaml#
$schema: http://devicetree.org/meta-schemas/core.yaml#

title: MediaTek MT6363 and MT6369 SPMI PMICs

maintainers:
  - serlk <22211586+Serlk@users.noreply.github.com>

description: |
  The MT6363 and MT6369 are Power Management ICs connected to the SoC over
  SPMI. MT6363 is the main PMIC: it provides the buck converters and LDOs
  for the SoC, the power and home keys and an AUXADC. MT6369 is a second
  PMIC with more LDOs (USB, SD card, connectivity, audio).

  The PMIC is an interrupt controller for its functions: the interrupts are
  signalled to the SPMI controller as Request Capable Slave (RCS) messages.

properties:
  compatible:
    enum:
      - mediatek,mt6363
      - mediatek,mt6369

  reg:
    maxItems: 1

  interrupts:
    maxItems: 1

  interrupt-controller: true

  "#interrupt-cells":
    const: 3
    description: |
      cell 1: SPMI slave ID of this PMIC
      cell 2: PMIC interrupt number
      cell 3: interrupt flags, as defined in
              dt-bindings/interrupt-controller/irq.h

  "#address-cells":
    const: 1

  "#size-cells":
    const: 0

  adc:
    type: object
    $ref: /schemas/iio/adc/mediatek,mt6359-auxadc.yaml#
    unevaluatedProperties: false

  keys:
    type: object
    $ref: /schemas/input/mediatek,pmic-keys.yaml#
    unevaluatedProperties: false

  regulators:
    type: object
    $ref: /schemas/regulator/mediatek,mt6369-regulator.yaml#
    unevaluatedProperties: false

patternProperties:
  "^regulators@[0-9a-f]+$":
    type: object
    $ref: /schemas/regulator/mediatek,mt6363-regulator.yaml#
    unevaluatedProperties: false

required:
  - compatible
  - reg
  - interrupts
  - interrupt-controller
  - "#interrupt-cells"

allOf:
  - if:
      properties:
        compatible:
          const: mediatek,mt6363
    then:
      properties:
        regulators: false
      required:
        - "#address-cells"
        - "#size-cells"
    else:
      properties:
        adc: false
        keys: false
      patternProperties:
        "^regulators@[0-9a-f]+$": false

additionalProperties: false

examples:
  - |
    #include <dt-bindings/input/input.h>
    #include <dt-bindings/interrupt-controller/irq.h>
    #include <dt-bindings/spmi/spmi.h>

    spmi {
        #address-cells = <2>;
        #size-cells = <0>;

        pmic@4 {
            compatible = "mediatek,mt6363";
            reg = <0x4 SPMI_USID>;
            interrupts = <0x4 0 IRQ_TYPE_LEVEL_HIGH>;
            interrupt-controller;
            #interrupt-cells = <3>;
            #address-cells = <1>;
            #size-cells = <0>;

            keys {
                compatible = "mediatek,mt6363-keys";

                power {
                    linux,keycodes = <KEY_POWER>;
                    wakeup-source;
                };
            };

            regulators@30 {
                compatible = "mediatek,mt6363-regulator";
                reg = <0x30>;

                vbuck5 {
                    regulator-name = "vproc-b";
                    regulator-always-on;
                };
            };
        };

        pmic@5 {
            compatible = "mediatek,mt6369";
            reg = <0x5 SPMI_USID>;
            interrupts = <0x5 0 IRQ_TYPE_LEVEL_HIGH>;
            interrupt-controller;
            #interrupt-cells = <3>;

            regulators {
                compatible = "mediatek,mt6369-regulator";

                vusb {
                    regulator-name = "vusb";
                    regulator-always-on;
                };
            };
        };
    };
```

## Documentation/devicetree/bindings/mfd/mediatek,mt6375.yaml
```yaml
# SPDX-License-Identifier: (GPL-2.0-only OR BSD-2-Clause)
%YAML 1.2
---
$id: http://devicetree.org/schemas/mfd/mediatek,mt6375.yaml#
$schema: http://devicetree.org/meta-schemas/core.yaml#

title: MediaTek MT6375 SubPMIC

maintainers:
  - serlk <22211586+Serlk@users.noreply.github.com>

description: |
  The MT6375 integrates a switching single cell Li-ion charger with BC1.2
  detection, an ADC, a coulomb counter and a USB Type-C/PD port controller.
  It answers on several I2C addresses; the node describes the PMU address
  0x34, the others are derived from it. The device collects the events of
  all blocks and signals them on one interrupt line.

properties:
  compatible:
    const: mediatek,mt6375

  reg:
    maxItems: 1

  interrupts:
    maxItems: 1

  interrupt-controller: true

  "#interrupt-cells":
    const: 1
    description:
      The event number, 8 * (register - 0x1d0) + bit.

  adc:
    type: object
    additionalProperties: false
    description: |
      The ADC: one-shot conversions of the charger and Type-C port voltages
      and currents and the die temperature. The channel numbers are in
      include/dt-bindings/iio/adc/mediatek,mt6375-adc.h.

    properties:
      compatible:
        const: mediatek,mt6375-adc

      "#io-channel-cells":
        const: 1

    required:
      - compatible
      - "#io-channel-cells"

  charger:
    type: object
    additionalProperties: false
    description: The switching charger.

    properties:
      compatible:
        const: mediatek,mt6375-chg

      interrupts:
        minItems: 1
        maxItems: 6

      interrupt-names:
        minItems: 1
        maxItems: 6
        items:
          enum: [ pwr_rdy, detach, vbus_ov, chg_tout, chg_batov, bc12_dn ]

      io-channels:
        minItems: 2
        items:
          - description: VBUS at the charger input
          - description: charger input current
          - description: battery voltage
          - description: battery current
          - description: charger die temperature
          - description: battery thermistor (TS) voltage

      io-channel-names:
        minItems: 2
        items:
          - const: vbus
          - const: ibus
          - const: vbat
          - const: ibat
          - const: temp_jc
          - const: ts

      phys:
        maxItems: 1
        description:
          The U2 port of the USB PHY that switches D+/D- to the charger for
          BC1.2 port detection.

      phy-names:
        const: usb2-phy

      mediatek,jeita-cool-celsius:
        description: Below this battery temperature the cool band applies.

      mediatek,jeita-warm-celsius:
        description: From this battery temperature on the warm band applies.

      mediatek,jeita-hysteresis-celsius:
        description: Hysteresis back into the normal band (1..10, default 3).

      mediatek,jeita-cool-charge-voltage-microvolt:
        description: Charge voltage in the cool band.

      mediatek,jeita-cool-charge-current-microamp:
        description: Charge current in the cool band; 0 is no charging.

      mediatek,jeita-warm-charge-voltage-microvolt:
        description: Charge voltage in the warm band.

      mediatek,jeita-warm-charge-current-microamp:
        description: Charge current in the warm band; 0 is no charging.

      mediatek,charge-in-suspend:
        type: boolean
        description:
          Keep charging in system sleep (normal band, reduced current, the
          battery checked again at periodic wake-ups).

      mediatek,suspend-charge-current-microamp:
        description: Charge current in system sleep (default 500000).

      mediatek,suspend-max-celsius:
        description:
          No charging in system sleep from this battery temperature on
          (default 40).

      monitored-battery:
        description: |
          Battery the charger feeds. Its constant-charge-voltage-max-microvolt
          and constant-charge-current-max-microamp are the upper limits the
          driver programs and accepts; without them the charger is only
          monitored. operating-range-celsius is the charging window and
          charge-term-current-microamp the termination current.

      otg:
        type: object
        $ref: /schemas/regulator/regulator.yaml#
        unevaluatedProperties: false
        description:
          The OTG boost of the charger, VBUS out for a USB host role
          (4.85..5.5 V, 0.5..2.4 A). The Type-C port controller takes it
          as its vbus-source-supply.

    required:
      - compatible

  tcpc:
    type: object
    additionalProperties: false
    description: The USB Type-C/Power Delivery port controller.

    properties:
      compatible:
        const: mediatek,mt6375-tcpc

      interrupts:
        maxItems: 1

      interrupt-names:
        const: pd_evt

      vbus-source-supply:
        description: The supply the port sources VBUS from (the charger's OTG boost).

      connector:
        type: object
        $ref: /schemas/connector/usb-connector.yaml#
        unevaluatedProperties: false

    required:
      - compatible
      - interrupts
      - interrupt-names
      - connector

required:
  - compatible
  - reg
  - interrupts
  - interrupt-controller
  - "#interrupt-cells"

additionalProperties: false

examples:
  - |
    #include <dt-bindings/interrupt-controller/irq.h>
    #include <dt-bindings/usb/pd.h>

    i2c {
        #address-cells = <1>;
        #size-cells = <0>;

        pmic@34 {
            compatible = "mediatek,mt6375";
            reg = <0x34>;
            interrupts = <15 IRQ_TYPE_LEVEL_LOW>;
            interrupt-controller;
            #interrupt-cells = <1>;

            mt6375_adc: adc {
                compatible = "mediatek,mt6375-adc";
                #io-channel-cells = <1>;
            };

            charger {
                compatible = "mediatek,mt6375-chg";
                interrupts = <0>, <1>, <8>, <11>, <9>, <31>;
                interrupt-names = "pwr_rdy", "detach", "vbus_ov",
                                  "chg_tout", "chg_batov", "bc12_dn";
                io-channels = <&mt6375_adc 1>, <&mt6375_adc 5>;
                io-channel-names = "vbus", "ibus";
            };

            tcpc {
                compatible = "mediatek,mt6375-tcpc";
                interrupts = <120>;
                interrupt-names = "pd_evt";

                connector {
                    compatible = "usb-c-connector";
                    data-role = "device";
                    power-role = "sink";
                    self-powered;
                    sink-pdos = <PDO_FIXED(5000, 2000, PDO_FIXED_USB_COMM)>;
                    op-sink-microwatt = <10000000>;
                };
            };
        };
    };
```

## Documentation/devicetree/bindings/mfd/mediatek,mt6685.yaml
```yaml
# SPDX-License-Identifier: (GPL-2.0-only OR BSD-2-Clause)
%YAML 1.2
---
$id: http://devicetree.org/schemas/mfd/mediatek,mt6685.yaml#
$schema: http://devicetree.org/meta-schemas/core.yaml#

title: MediaTek MT6685 clock buffer and RTC chip

maintainers:
  - serlk <22211586+Serlk@users.noreply.github.com>

description: |
  The MT6685 is a companion chip on the SPMI bus of MediaTek smartphone
  SoCs (MT6878 and others). It contains the 26 MHz clock buffers (XO) and
  the RTC. It signals interrupts to the SPMI controller with Request
  Capable Slave messages, so its functions take their interrupt from the
  SPMI controller by slave ID.

properties:
  compatible:
    const: mediatek,mt6685

  reg:
    maxItems: 1

  clock-controller:
    type: object
    additionalProperties: false
    description:
      The software switched clock buffer BBCK5, the 26 MHz reference of
      the audio codec of the second PMIC.

    properties:
      compatible:
        const: mediatek,mt6685-audclk

      "#clock-cells":
        const: 0

      clock-output-names:
        maxItems: 1

    required:
      - compatible
      - "#clock-cells"

  rtc:
    type: object
    additionalProperties: false

    properties:
      compatible:
        const: mediatek,mt6685-rtc

      interrupts:
        maxItems: 1

    required:
      - compatible
      - interrupts

required:
  - compatible
  - reg

additionalProperties: false

examples:
  - |
    #include <dt-bindings/interrupt-controller/irq.h>
    #include <dt-bindings/spmi/spmi.h>

    spmi {
        interrupt-controller;
        #interrupt-cells = <3>;
        #address-cells = <2>;
        #size-cells = <0>;

        pmic@9 {
            compatible = "mediatek,mt6685";
            reg = <0x9 SPMI_USID>;

            clock-controller {
                compatible = "mediatek,mt6685-audclk";
                #clock-cells = <0>;
            };

            rtc {
                compatible = "mediatek,mt6685-rtc";
                interrupts = <0x9 0 IRQ_TYPE_LEVEL_HIGH>;
            };
        };
    };
```

## Documentation/devicetree/bindings/net/bluetooth/mediatek,mt6878-bt.yaml
```yaml
# SPDX-License-Identifier: (GPL-2.0-only OR BSD-2-Clause)
%YAML 1.2
---
$id: http://devicetree.org/schemas/net/bluetooth/mediatek,mt6878-bt.yaml#
$schema: http://devicetree.org/meta-schemas/core.yaml#

title: MediaTek MT6878 CONNSYS Bluetooth

maintainers:
  - serlk <22211586+Serlk@users.noreply.github.com>

description:
  The Bluetooth core (BGF) of the connectivity subsystem (CONNSYS) of
  MediaTek MT6878. It is powered through CONNINFRA, its firmware is loaded
  into the CONNSYS EMI by the boot loader, and HCI packets are exchanged
  through rings in the same EMI with software interrupts both ways.

allOf:
  - $ref: bluetooth-controller.yaml#

properties:
  compatible:
    const: mediatek,mt6878-bt

  reg:
    items:
      - description: BGF registers
      - description: CONN_INFRA registers, shared with CONNINFRA and Wi-Fi

  reg-names:
    items:
      - const: bgf
      - const: conninfra

  interrupts:
    items:
      - description: BGF to AP software interrupt
      - description: CONN to AP interrupt (BGF bus timeout)

  interrupt-names:
    items:
      - const: bgf2ap
      - const: conn2ap

  mediatek,conninfra:
    $ref: /schemas/types.yaml#/definitions/phandle
    description: CONNINFRA node powering CONNSYS

required:
  - compatible
  - reg
  - reg-names
  - interrupts
  - interrupt-names
  - mediatek,conninfra

unevaluatedProperties: false

examples:
  - |
    #include <dt-bindings/interrupt-controller/arm-gic.h>
    #include <dt-bindings/interrupt-controller/irq.h>

    bluetooth@18800000 {
        compatible = "mediatek,mt6878-bt";
        reg = <0x18800000 0x30000>, <0x18000000 0x100000>;
        reg-names = "bgf", "conninfra";
        interrupts = <GIC_SPI 693 IRQ_TYPE_LEVEL_HIGH>,
                     <GIC_SPI 132 IRQ_TYPE_LEVEL_HIGH>;
        interrupt-names = "bgf2ap", "conn2ap";
        mediatek,conninfra = <&consys>;
        local-bd-address = [00 00 00 00 00 00];
    };
```
