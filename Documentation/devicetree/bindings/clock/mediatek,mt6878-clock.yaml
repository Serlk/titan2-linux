## Documentation/devicetree/bindings/net/mediatek,mt6878-ccci.yaml
```yaml
# SPDX-License-Identifier: (GPL-2.0-only OR BSD-2-Clause)
%YAML 1.2
---
$id: http://devicetree.org/schemas/net/mediatek,mt6878-ccci.yaml#
$schema: http://devicetree.org/meta-schemas/core.yaml#

title: MediaTek SoC-integrated modem (CCCI)

maintainers:
  - serlk <22211586+Serlk@users.noreply.github.com>

description: |
  The modem built into MediaTek smartphone SoCs talks to the application
  processor through CCCI (Cross Core Communication Interface): control
  channels over the CCIF mailbox and its SRAM, network data over DPMAIF.

  The bootloader loads and authenticates the modem firmware, reserves the
  modem and AP/modem shared memory and writes where it left the modem
  arguments into the "ccci,modem_info_v2" property of this node. The stock
  MediaTek bootloader finds the node by its path, "/soc/mddriver".

properties:
  $nodename:
    pattern: "^mddriver@[0-9a-f]+$"

  compatible:
    const: mediatek,mt6878-ccci

  reg:
    minItems: 3
    items:
      - description: modem side registers
      - description: CCIF0, AP side
      - description: CCIF0, modem side
      - description: infracfg block holding the CCIF0 reset

  reg-names:
    minItems: 3
    items:
      - const: md
      - const: ccif-ap
      - const: ccif-md
      - const: infra

  interrupts:
    items:
      - description: modem watchdog
      - description: CCIF0 channel interrupt
      - description: CCIF0 exception/wakeup interrupt

  interrupt-names:
    items:
      - const: wdt
      - const: ccif0
      - const: ccif1

  clocks:
    maxItems: 6

  clock-names:
    items:
      - const: ccif-ap
      - const: ccif-md
      - const: ccif1-ap
      - const: ccif1-md
      - const: ccif4-md
      - const: ccif5-md

  mediatek,ccif-sram-size:
    $ref: /schemas/types.yaml#/definitions/uint32
    description: Size in bytes of the CCIF channel data SRAM.
    default: 512

  mediatek,ccif-reset-bit:
    $ref: /schemas/types.yaml#/definitions/uint32
    maximum: 31
    description: Bit of CCIF0 in the reset set/clear registers of "infra".

  mediatek,scpsys:
    $ref: /schemas/types.yaml#/definitions/phandle
    description: SCPSYS syscon, to read the modem power state.

  mediatek,topckgen:
    $ref: /schemas/types.yaml#/definitions/phandle
    description: topckgen syscon holding the modem clock gates.

  power-domains:
    maxItems: 1
    description:
      The modem (MD) power domain. Leave it out while the bootloader
      started modem is to be left alone: with it, the domain is attached
      and held from probe on.

  md-vmodem-supply:
    description: Modem core supply.

  md-vsram-supply:
    description: Modem SRAM supply.

  md-vdigrf-supply:
    description: Modem digital RF supply.

  ccci,modem_info_v2:
    $ref: /schemas/types.yaml#/definitions/uint8-array
    description:
      Written by the bootloader. Location, size and format version of
      the table of modem arguments, little-endian.

required:
  - compatible
  - reg
  - reg-names
  - interrupts
  - interrupt-names
  - clocks
  - clock-names

additionalProperties: false

examples:
  - |
    #include <dt-bindings/clock/mediatek,mt6878-clock.h>
    #include <dt-bindings/interrupt-controller/arm-gic.h>

    mddriver@d180000 {
        compatible = "mediatek,mt6878-ccci";
        reg = <0x0d180000 0x2000>,
              <0x10209000 0x1000>,
              <0x1020a000 0x1000>,
              <0x1020e000 0x1000>;
        reg-names = "md", "ccif-ap", "ccif-md", "infra";
        interrupts = <GIC_SPI 491 IRQ_TYPE_LEVEL_HIGH>,
                     <GIC_SPI 228 IRQ_TYPE_LEVEL_HIGH>,
                     <GIC_SPI 229 IRQ_TYPE_LEVEL_HIGH>;
        interrupt-names = "wdt", "ccif0", "ccif1";
        clocks = <&infracfg_ao CLK_IFRAO_CCIF_AP>,
                 <&infracfg_ao CLK_IFRAO_CCIF_MD>,
                 <&infracfg_ao CLK_IFRAO_CCIF1_AP>,
                 <&infracfg_ao CLK_IFRAO_CCIF1_MD>,
                 <&infracfg_ao CLK_IFRAO_CCIF4_MD>,
                 <&infracfg_ao CLK_IFRAO_CCIF5_MD>;
        clock-names = "ccif-ap", "ccif-md", "ccif1-ap",
                      "ccif1-md", "ccif4-md", "ccif5-md";
        mediatek,ccif-reset-bit = <26>;
    };
```

## Documentation/devicetree/bindings/net/mediatek,mt6878-dpmaif.yaml
```yaml
# SPDX-License-Identifier: (GPL-2.0-only OR BSD-2-Clause)
%YAML 1.2
---
$id: http://devicetree.org/schemas/net/mediatek,mt6878-dpmaif.yaml#
$schema: http://devicetree.org/meta-schemas/core.yaml#

title: MediaTek DPMAIF data path DMA of the SoC-integrated modem

maintainers:
  - serlk <22211586+Serlk@users.noreply.github.com>

description: |
  DPMAIF (Data Path Modem AP Interface) moves the network packets between
  the application processor and the modem built into the SoC, with
  descriptor rings in AP memory. It has an always-on part (AO) and a part
  in a power-down domain (PD) that also holds its SRAM configuration
  mirror. The modem node (mediatek,mt6878-ccci) points at this node and
  its driver drives the block, as part of the modem start and stop. The
  PD half of the block is reset through the infracfg window of the modem
  node, which it shares with the CCIF reset.

properties:
  compatible:
    const: mediatek,mt6878-dpmaif

  reg:
    items:
      - description: always-on registers (AO UL, AO DL, modem DL)
      - description: power-down registers (UL, DL, DMA, AP misc, SRAM mirror)
      - description: modem side misc registers of the power-down part
      - description: power-down SRAM

  reg-names:
    items:
      - const: ao
      - const: pd
      - const: md-misc
      - const: sram

  interrupts:
    minItems: 1
    items:
      - description: transmit done, receive queue 0 and errors
      - description: receive queue 1, only used with receive offload

  clocks:
    items:
      - description: main clock
      - description: bus clock
      - description: 26 MHz clock

  clock-names:
    items:
      - const: main
      - const: blk
      - const: 26m

  mediatek,infracfg-ao:
    $ref: /schemas/types.yaml#/definitions/phandle
    description:
      infracfg_ao syscon holding the always-on reset and the bus enable
      of the block.

required:
  - compatible
  - reg
  - reg-names
  - interrupts
  - clocks
  - clock-names
  - mediatek,infracfg-ao

additionalProperties: false

examples:
  - |
    #include <dt-bindings/clock/mediatek,mt6878-clock.h>
    #include <dt-bindings/interrupt-controller/arm-gic.h>

    dpmaif@10014000 {
        compatible = "mediatek,mt6878-dpmaif";
        reg = <0x10014000 0x1000>,
              <0x1022d000 0x1000>,
              <0x1022c000 0x1000>,
              <0x1022e000 0x1000>;
        reg-names = "ao", "pd", "md-misc", "sram";
        interrupts = <GIC_SPI 238 IRQ_TYPE_LEVEL_HIGH>,
                     <GIC_SPI 259 IRQ_TYPE_LEVEL_HIGH>;
        clocks = <&infracfg_ao CLK_IFRAO_DPMAIF_MAIN>,
                 <&infracfg_ao CLK_IFRAO_CLDMA_BCLK>,
                 <&infracfg_ao CLK_IFRAO_RG_MMW_DPMAIF26M>;
        clock-names = "main", "blk", "26m";
        mediatek,infracfg-ao = <&infracfg_ao>;
    };
```

## Documentation/devicetree/bindings/net/wireless/mediatek,mt6878-wifi.yaml
```yaml
# SPDX-License-Identifier: (GPL-2.0-only OR BSD-2-Clause)
%YAML 1.2
---
$id: http://devicetree.org/schemas/net/wireless/mediatek,mt6878-wifi.yaml#
$schema: http://devicetree.org/meta-schemas/core.yaml#

title: MediaTek MT6878 CONNSYS Wi-Fi

maintainers:
  - serlk <22211586+Serlk@users.noreply.github.com>

description:
  The Wi-Fi 6 core (MT7921 class, CONNAC2) of the connectivity subsystem
  (CONNSYS) of MediaTek MT6878, attached to the AP over AXI. It is powered
  through CONNINFRA. The boot loader loads its firmware into the CONNSYS
  EMI and carves out the DMA pool for the WFDMA rings; it adds the
  memory-region phandle to this node and reads the emi-* properties.

allOf:
  - $ref: ieee80211.yaml#

properties:
  compatible:
    const: mediatek,mt6878-wifi

  reg:
    maxItems: 1
    description:
      CONNSYS register window as seen from the AP, CONN_INFRA at offset 0
      and WFSYS at offset 0x400000 (0x700000 bytes)

  interrupts:
    items:
      - description: WFDMA interrupt
      - description: WF to AP software interrupt (CCIF)

  interrupt-names:
    items:
      - const: wfdma
      - const: sw

  memory-region:
    maxItems: 1
    description:
      shared-dma-pool for the WFDMA rings, added by the boot loader

  mediatek,conninfra:
    $ref: /schemas/types.yaml#/definitions/phandle
    description: CONNINFRA node powering CONNSYS

  emi-size:
    $ref: /schemas/types.yaml#/definitions/uint32
    description: Size of the WFDMA pool, read by the boot loader only

  emi-alignment:
    $ref: /schemas/types.yaml#/definitions/uint32
    description: Alignment of the WFDMA pool, read by the boot loader only

  emi-max-addr:
    $ref: /schemas/types.yaml#/definitions/uint32
    description: Upper limit for the WFDMA pool, read by the boot loader only

required:
  - compatible
  - reg
  - interrupts
  - interrupt-names
  - mediatek,conninfra

unevaluatedProperties: false

examples:
  - |
    #include <dt-bindings/interrupt-controller/arm-gic.h>
    #include <dt-bindings/interrupt-controller/irq.h>

    wifi@18000000 {
        compatible = "mediatek,mt6878-wifi";
        reg = <0x18000000 0x700000>;
        interrupts = <GIC_SPI 484 IRQ_TYPE_LEVEL_HIGH>,
                     <GIC_SPI 692 IRQ_TYPE_LEVEL_HIGH>;
        interrupt-names = "wfdma", "sw";
        mediatek,conninfra = <&consys>;
        emi-size = <0x1400000>;
        emi-alignment = <0x1000000>;
        emi-max-addr = <0xc0000000>;
    };
```

## Documentation/devicetree/bindings/nvmem/mediatek,mt6878-devinfo.yaml
```yaml
# SPDX-License-Identifier: (GPL-2.0-only OR BSD-2-Clause)
%YAML 1.2
---
$id: http://devicetree.org/schemas/nvmem/mediatek,mt6878-devinfo.yaml#
$schema: http://devicetree.org/meta-schemas/core.yaml#

title: MediaTek boot loader provided device information (efuse copy)

description: |
  On MediaTek smartphone SoCs such as the MT6878 the efuse block cannot be
  read from the normal world. The boot loader copies it into the
  "atag,devinfo" property of /chosen (a little-endian word count followed
  by the words). This node exposes that copy as an NVMEM provider; cell
  offsets are byte offsets into the copied words, as in the vendor device
  trees.

maintainers:
  - serlk <22211586+Serlk@users.noreply.github.com>

allOf:
  - $ref: nvmem.yaml#
  - $ref: nvmem-deprecated-cells.yaml#

properties:
  $nodename:
    pattern: "^efuse(-[a-z0-9]+)?$"

  compatible:
    const: mediatek,mt6878-devinfo

required:
  - compatible

unevaluatedProperties: false

examples:
  - |
    efuse {
        compatible = "mediatek,mt6878-devinfo";
        #address-cells = <1>;
        #size-cells = <1>;

        lvts_efuse_data1: lvts-data1@1ac {
            reg = <0x1ac 0x30>;
        };
    };
```

## Documentation/devicetree/bindings/power/mediatek,mt8196-gpufreq.yaml
```yaml
# SPDX-License-Identifier: GPL-2.0-only OR BSD-2-Clause
%YAML 1.2
---
$id: http://devicetree.org/schemas/power/mediatek,mt8196-gpufreq.yaml#
$schema: http://devicetree.org/meta-schemas/core.yaml#

title: MediaTek MFlexGraphics Power and Frequency Controller

maintainers:
  - Nicolas Frattaroli <nicolas.frattaroli@collabora.com>

description: |
  A special-purpose embedded MCU to control power and frequency of GPU devices
  using MediaTek Flexible Graphics integration hardware.

  On the MT6878, the boot firmware loads and starts the MCU in the MFG0 power
  domain, and the MCU drives the GPU supplies, PLLs and power domains itself.
  The operating system only sends it requests through the mailbox, and does
  not control any of its clocks or supplies.

properties:
  $nodename:
    pattern: '^power-controller@[a-f0-9]+$'

  compatible:
    enum:
      - mediatek,mt6878-gpufreq
      - mediatek,mt8196-gpufreq

  reg:
    minItems: 1
    items:
      - description: GPR memory area
      - description: RPC memory area
      - description: SoC variant ID register

  reg-names:
    minItems: 1
    items:
      - const: gpr
      - const: rpc
      - const: hw-revision

  clocks:
    items:
      - description: main clock of the embedded controller (EB)
      - description: core PLL
      - description: stack 0 PLL
      - description: stack 1 PLL

  clock-names:
    items:
      - const: eb
      - const: core
      - const: stack0
      - const: stack1

  mboxes:
    minItems: 1
    items:
      - description: FastDVFS events
      - description: frequency control
      - description: sleep control
      - description: timer control
      - description: frequency hopping control
      - description: hardware voter control
      - description: FastDVFS control

  mbox-names:
    minItems: 1
    items:
      - const: fast-dvfs-event
      - const: gpufreq
      - const: sleep
      - const: timer
      - const: fhctl
      - const: ccf
      - const: fast-dvfs

  memory-region:
    items:
      - description: phandle to the GPUEB shared memory

  mediatek,scpsys:
    $ref: /schemas/types.yaml#/definitions/phandle
    description:
      Phandle to the SCPSYS syscon holding the power control register of the
      MFG0 domain the MCU runs in, to check that it is up before the MCU SRAM
      is accessed.

  "#clock-cells":
    const: 1

  "#nvmem-cell-cells":
    const: 0

  "#power-domain-cells":
    const: 0

  shader-present:
    type: object

dependencies:
  shader-present: [ "#nvmem-cell-cells" ]

required:
  - compatible
  - reg
  - reg-names
  - mboxes
  - mbox-names
  - "#clock-cells"
  - "#power-domain-cells"

allOf:
  - if:
      properties:
        compatible:
          contains:
            const: mediatek,mt6878-gpufreq
    then:
      description:
        The shared memory is a carveout the bootloader creates, which has no
        phandle. Without memory-region, the reserved-memory node compatible
        with "mediatek,me_GPUEB_SHARED" is used.
      properties:
        reg:
          maxItems: 1
        reg-names:
          maxItems: 1
        clocks: false
        clock-names: false
        mboxes:
          maxItems: 1
        mbox-names:
          maxItems: 1
      required:
        - mediatek,scpsys
    else:
      properties:
        reg:
          minItems: 3
        reg-names:
          minItems: 3
        mboxes:
          minItems: 7
        mbox-names:
          minItems: 7
        mediatek,scpsys: false
      required:
        - clocks
        - clock-names
        - memory-region

additionalProperties: false

examples:
  - |
    #include <dt-bindings/clock/mediatek,mt8196-clock.h>

    power-controller@4b09fd00 {
        compatible = "mediatek,mt8196-gpufreq";
        reg = <0x4b09fd00 0x80>,
              <0x4b800000 0x1000>,
              <0x4b860128 0x4>;
        reg-names = "gpr", "rpc", "hw-revision";
        clocks = <&topckgen CLK_TOP_MFG_EB>,
                 <&mfgpll CLK_MFG_AO_MFGPLL>,
                 <&mfgpll_sc0 CLK_MFGSC0_AO_MFGPLL_SC0>,
                 <&mfgpll_sc1 CLK_MFGSC1_AO_MFGPLL_SC1>;
        clock-names = "eb", "core", "stack0", "stack1";
        mboxes = <&gpueb_mbox 0>, <&gpueb_mbox 1>, <&gpueb_mbox 2>,
                 <&gpueb_mbox 3>, <&gpueb_mbox 4>, <&gpueb_mbox 5>,
                 <&gpueb_mbox 7>;
        mbox-names = "fast-dvfs-event", "gpufreq", "sleep", "timer", "fhctl",
                     "ccf", "fast-dvfs";
        memory-region = <&gpueb_shared_memory>;
        #clock-cells = <1>;
        #nvmem-cell-cells = <0>;
        #power-domain-cells = <0>;

        shader-present {
        };
    };

  - |
    power-controller@13c3fd1c {
        compatible = "mediatek,mt6878-gpufreq";
        reg = <0x13c3fd1c 0x64>;
        reg-names = "gpr";
        mboxes = <&gpueb_mbox 1>;
        mbox-names = "gpufreq";
        mediatek,scpsys = <&scpsys>;
        #clock-cells = <1>;
        #nvmem-cell-cells = <0>;
        #power-domain-cells = <0>;
    };
```
