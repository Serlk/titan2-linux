## Documentation/devicetree/bindings/regulator/mediatek,mt6369-regulator.yaml
```yaml
# SPDX-License-Identifier: (GPL-2.0-only OR BSD-2-Clause)
%YAML 1.2
---
$id: http://devicetree.org/schemas/regulator/mediatek,mt6369-regulator.yaml#
$schema: http://devicetree.org/meta-schemas/core.yaml#

title: MediaTek MT6369 PMIC Regulators

maintainers:
  - serlk <22211586+Serlk@users.noreply.github.com>

description:
  The MT6369 SPMI PMIC provides 2 BUCK and 15 LDO (Low DropOut) regulators.
  The node is a child of the MT6369 PMIC node, see
  Documentation/devicetree/bindings/mfd/mediatek,mt6363.yaml.

properties:
  compatible:
    const: mediatek,mt6369-regulator

patternProperties:
  "^v(buck1|pa)$":
    description: Buck regulators
    type: object
    $ref: regulator.yaml#
    unevaluatedProperties: false
    properties:
      regulator-allowed-modes:
        description: |
          Buck regulator operating modes allowed. Valid values below.
            0 - Normal mode with automatic power saving, reducing the switching
                frequency when light load conditions are detected
            1 - Forced Continuous Conduction mode (FCCM) for improved voltage
                regulation accuracy with constant switching frequency but lower
                regulator efficiency
            2 - Forced Low Power mode for improved regulator efficiency, used
                when no heavy load is expected
        maxItems: 3
        items:
          enum: [ 0, 1, 2 ]

  "^v(sram-core|digrf|aux18|usb|ibr|io28|fp|tp|mch|mc|cn33-1|cn33-2|aud28|ant18|efuse)$":
    description: LDO regulators
    type: object
    $ref: regulator.yaml#
    unevaluatedProperties: false
    properties:
      regulator-allowed-modes:
        description: |
          LDO regulator operating modes allowed. Valid values below.
            0 - Normal mode
            2 - Forced Low Power mode, for light loads
        maxItems: 2
        items:
          enum: [ 0, 2 ]

required:
  - compatible

additionalProperties: false

examples:
  - |
    regulators {
        compatible = "mediatek,mt6369-regulator";

        vusb {
            regulator-name = "vusb";
            regulator-always-on;
        };

        vmc {
            regulator-name = "vmc";
            regulator-min-microvolt = <1800000>;
            regulator-max-microvolt = <3300000>;
        };
    };
```

## Documentation/devicetree/bindings/soc/mediatek/mediatek,mt6878-consys.yaml
```yaml
# SPDX-License-Identifier: (GPL-2.0-only OR BSD-2-Clause)
%YAML 1.2
---
$id: http://devicetree.org/schemas/soc/mediatek/mediatek,mt6878-consys.yaml#
$schema: http://devicetree.org/meta-schemas/core.yaml#

title: MediaTek MT6878 CONNINFRA (connectivity subsystem infrastructure)

maintainers:
  - serlk <22211586+Serlk@users.noreply.github.com>

description:
  CONNINFRA powers and clocks the connectivity subsystem (CONNSYS) of
  MediaTek smartphone SoCs and connects it to the external RF die (A-die).
  The Wi-Fi, Bluetooth, GNSS and FM blocks of CONNSYS depend on it.
  The compatible names the A-die. On MT6878 boards the boot loader detects
  the A-die and rewrites the compatible of this node accordingly.

properties:
  compatible:
    enum:
      - mediatek,mt6878-6631-consys
      - mediatek,mt6878-6631-6686-consys
      - mediatek,mt6878-6637-consys

  reg:
    minItems: 1
    items:
      - description: CONN_INFRA register window
      - description: Wi-Fi subsystem (WFSYS) register window
      - description: SRCLKEN_RC (clock request controller), read only

  reg-names:
    minItems: 1
    items:
      - const: conninfra
      - const: wfsys
      - const: srclken-rc

  power-domains:
    maxItems: 1

  vcn13-supply:
    description: 1.35 V supply of the D-die analog front end and the A-die

  vrfio18-supply:
    description: 1.7 V I/O supply of the A-die and the crystal

  vcn33-1-supply:
    description: Wi-Fi and Bluetooth RF front end supply

  vcn33-2-supply:
    description: Wi-Fi RF front end supply

  vant18-supply:
    description: GNSS LNA supply

  pinctrl-names:
    minItems: 2
    items:
      - const: idle
      - const: active
      - const: adie-cfg

  pinctrl-0: true
  pinctrl-1: true
  pinctrl-2:
    description:
      As "active", with the CONN_WF_CTRL2 pin as a GPIO that tells the A-die
      the co-clock frequency while it leaves reset

  mediatek,co-clock-52mhz:
    type: boolean
    description: The A-die is clocked by a 52 MHz instead of a 26 MHz co-clock

  mediatek,topckgen:
    $ref: /schemas/types.yaml#/definitions/phandle
    description: TOPCKGEN syscon, holding the CONNSYS host clock request

  hwid-node:
    $ref: /schemas/types.yaml#/definitions/uint32-array
    maxItems: 4
    description:
      GPIOs whose levels select the A-die, read by the boot loader only

  adie-sku:
    $ref: /schemas/types.yaml#/definitions/uint32-array
    maxItems: 8
    description:
      A-die for each hwid-node value (0 MT6637, 1 MT6631, 2 MT6631 with
      MT6686), read by the boot loader only

  emi-addr:
    $ref: /schemas/types.yaml#/definitions/uint64
    description:
      Base of the CONNSYS EMI region, written by the boot loader after it
      placed the firmware there

  emi-size:
    $ref: /schemas/types.yaml#/definitions/uint32
    description: Size of the CONNSYS EMI region

patternProperties:
  "^(ro|rw|ro-bt|ro-gps|ro-wifi)-emi-size$":
    $ref: /schemas/types.yaml#/definitions/uint32
    description:
      Layout of the CONNSYS EMI region, read by the boot loader only

  "^emi-(alignment|max-addr)$":
    $ref: /schemas/types.yaml#/definitions/uint32
    description:
      Placement of the CONNSYS EMI region, read by the boot loader only

required:
  - compatible
  - reg
  - power-domains
  - vcn13-supply
  - vrfio18-supply

additionalProperties: false

examples:
  - |
    soc {
        #address-cells = <1>;
        #size-cells = <1>;

        consys@18000000 {
            compatible = "mediatek,mt6878-6637-consys";
            reg = <0x18000000 0x100000>, <0x18400000 0x200000>;
            reg-names = "conninfra", "wfsys";
            power-domains = <&spm 0>;
            vcn13-supply = <&mt6363_vcn13>;
            vrfio18-supply = <&mt6363_vrfio18>;
            mediatek,topckgen = <&topckgen>;
            hwid-node = <92 132 131>;
            adie-sku = <1 1 0 0 2 2 1 0>;
            emi-size = <0xc00000>;
            ro-emi-size = <0x680000>;
            rw-emi-size = <0x480000>;
            emi-alignment = <0x100000>;
            emi-max-addr = <0x90000000>;
        };
    };
```

## Documentation/devicetree/bindings/soc/mediatek/mediatek,mt6878-lpm.yaml
```yaml
# SPDX-License-Identifier: (GPL-2.0-only OR BSD-2-Clause)
%YAML 1.2
---
$id: http://devicetree.org/schemas/soc/mediatek/mediatek,mt6878-lpm.yaml#
$schema: http://devicetree.org/meta-schemas/core.yaml#

title: MediaTek MT6878 low power manager

maintainers:
  - serlk <22211586+Serlk@users.noreply.github.com>

description:
  The kernel side of the system low power handshake with the trusted
  firmware (BL31) and the SPM on the MT6878. System sleep is
  suspend-to-idle; the firmware turns the 26 MHz clock, the PLLs, the DRAM
  and the core supply down once every CPU reports that it suspends. The
  node is a child of the SCPSYS syscon, whose registers hold the SPM
  wake-up status.

properties:
  compatible:
    const: mediatek,mt6878-lpm

  interrupts:
    maxItems: 1
    description:
      The SPM interrupt the firmware sets pending to report a wake-up.

  mediatek,irq-remain:
    $ref: /schemas/types.yaml#/definitions/phandle-array
    description:
      Level interrupts to keep through MCUSYS off, each as the phandle of
      the device node and the index of the interrupt in it. The firmware
      mirrors them into the SYS_CIRQ while the GIC is powered down.
    items:
      items:
        - description: phandle of the device node
        - description: index of the interrupt in the node

required:
  - compatible
  - interrupts

additionalProperties: false

examples:
  - |
    #include <dt-bindings/interrupt-controller/arm-gic.h>
    #include <dt-bindings/interrupt-controller/irq.h>

    syscon@1c001000 {
        compatible = "mediatek,mt6878-scpsys", "syscon", "simple-mfd";
        reg = <0x1c001000 0x1000>;

        low-power-manager {
            compatible = "mediatek,mt6878-lpm";
            interrupts = <GIC_SPI 499 IRQ_TYPE_LEVEL_HIGH 0>;
        };
    };
```

## Documentation/devicetree/bindings/sound/foursemi,fs199x.yaml
```yaml
# SPDX-License-Identifier: (GPL-2.0-only OR BSD-2-Clause)
%YAML 1.2
---
$id: http://devicetree.org/schemas/sound/foursemi,fs199x.yaml#
$schema: http://devicetree.org/meta-schemas/core.yaml#

title: FourSemi FS199x Smart Audio Amplifier

maintainers:
  - serlk <22211586+Serlk@users.noreply.github.com>

description:
  Mono Class-D smart amplifier with a DSP for speaker protection, digital
  audio input over I2S, controlled over I2C. The register settings, the
  speaker model and the DSP effects come from a FourSemi firmware file.

allOf:
  - $ref: dai-common.yaml#

properties:
  compatible:
    const: foursemi,fs199x

  reg:
    maxItems: 1

  '#sound-dai-cells':
    const: 0

  pvdd-supply:
    description: Power stage supply (PVDD).

  dvdd-supply:
    description: Digital supply (DVDD).

  reset-gpios:
    maxItems: 1
    description:
      The SDZ pin, active low; asserted, it shuts the chip down.

  firmware-name:
    maxItems: 1
    description:
      FourSemi firmware file with the register scenes, the speaker model and
      the DSP effect parameters, generated by the FourSemi tuning tool for
      the speaker of the board.

  foursemi,speaker-re:
    $ref: /schemas/types.yaml#/definitions/uint32
    description:
      Nominal DC resistance of the speaker in the unit of the FourSemi
      tools, used for the speaker protection when the chip has no
      calibrated value in its OTP.

required:
  - compatible
  - reg
  - '#sound-dai-cells'
  - firmware-name

unevaluatedProperties: false

examples:
  - |
    #include <dt-bindings/gpio/gpio.h>
    i2c {
        #address-cells = <1>;
        #size-cells = <0>;
        audio-amplifier@34 {
            compatible = "foursemi,fs199x";
            reg = <0x34>;
            #sound-dai-cells = <0>;
            reset-gpios = <&gpio 29 GPIO_ACTIVE_LOW>;
            firmware-name = "frsm-spk1.bin";
            foursemi,speaker-re = <0x67fd>;
        };
    };
```

## Documentation/devicetree/bindings/sound/mediatek,mt6369-sound.yaml
```yaml
# SPDX-License-Identifier: (GPL-2.0-only OR BSD-2-Clause)
%YAML 1.2
---
$id: http://devicetree.org/schemas/sound/mediatek,mt6369-sound.yaml#
$schema: http://devicetree.org/meta-schemas/core.yaml#

title: MediaTek MT6369 audio codec

maintainers:
  - serlk <22211586+Serlk@users.noreply.github.com>

description: |
  The audio codec of the MT6369 SPMI PMIC: receiver, headphone and line
  outputs, two ADCs behind preamplifiers for the analog inputs AIN0, AIN1
  and AIN2. The audio data goes to and from the SoC audio front end (AFE)
  over the MTKAIF interface. Must be a child node of the MT6369 PMIC.

allOf:
  - $ref: dai-common.yaml#

properties:
  compatible:
    const: mediatek,mt6369-sound

  "#sound-dai-cells":
    const: 0

patternProperties:
  "^mediatek,mic-type-[0-2]$":
    $ref: /schemas/types.yaml#/definitions/uint32
    description: |
      Type of the microphone on AIN0, AIN1 and AIN2. AIN0 and AIN2 share
      MICBIAS0, AIN1 (headset) uses MICBIAS1. Defaults to 0.
    enum:
      - 0 # IDLE - not connected
      - 1 # ACC - analog mic with alternating coupling
      - 3 # DCC - analog mic with direct coupling
      - 4 # DCC_ECM_DIFF - electret condenser mic, differential
      - 5 # DCC_ECM_SINGLE - electret condenser mic, single ended

required:
  - compatible

unevaluatedProperties: false

examples:
  - |
    audio-codec {
        compatible = "mediatek,mt6369-sound";
        #sound-dai-cells = <0>;
        mediatek,mic-type-0 = <1>;
        mediatek,mic-type-1 = <1>;
        mediatek,mic-type-2 = <1>;
    };
```
