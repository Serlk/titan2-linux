## Documentation/devicetree/bindings/clock/mediatek,mt6878-clock.yaml
```yaml
# SPDX-License-Identifier: (GPL-2.0 OR BSD-2-Clause)
%YAML 1.2
---
$id: http://devicetree.org/schemas/clock/mediatek,mt6878-clock.yaml#
$schema: http://devicetree.org/meta-schemas/core.yaml#

title: MediaTek Functional Clock Controller for MT6878

maintainers:
  - Igor Belwon <igor.belwon@mentallysanemainliners.org>

description: |
  The clock architecture in MediaTek SoCs is structured like below:
  PLLs -->
          dividers -->
                      muxes
                           -->
                              clock gate

  The device nodes provide clock gate control in different IP blocks.
  The clock IDs are defined in
  include/dt-bindings/clock/mediatek,mt6878-clock.h.

properties:
  compatible:
    oneOf:
      - items:
          - enum:
              - mediatek,mt6878-camsys-main
              - mediatek,mt6878-camsys-mraw
              - mediatek,mt6878-camsys-rawa
              - mediatek,mt6878-camsys-rawb
              - mediatek,mt6878-camsys-vcore
              - mediatek,mt6878-camsys-yuva
              - mediatek,mt6878-camsys-yuvb
              - mediatek,mt6878-ccusys
              - mediatek,mt6878-imgsys
              - mediatek,mt6878-imgsys-traw
              - mediatek,mt6878-imgsys-vcore
              - mediatek,mt6878-imgsys-wpe1
              - mediatek,mt6878-imgsys-wpe2
              - mediatek,mt6878-imgsys1-dip-nr1
              - mediatek,mt6878-imgsys1-dip-nr2
              - mediatek,mt6878-imgsys1-dip-top
              - mediatek,mt6878-imp_iic_wrap-cs
              - mediatek,mt6878-imp_iic_wrap-es
              - mediatek,mt6878-imp_iic_wrap-ess
              - mediatek,mt6878-imp_iic_wrap-ws
              - mediatek,mt6878-infracfg-ao
              - mediatek,mt6878-mdpsys
              - mediatek,mt6878-mminfra-config
              - mediatek,mt6878-pericfg-ao
              - mediatek,mt6878-scp-cfg
              - mediatek,mt6878-vdecsys
              - mediatek,mt6878-vencsys
          - const: syscon
      - items:
          - enum:
              - mediatek,mt6878-ufscfg-ao
              - mediatek,mt6878-ufscfg-pdn
          - const: syscon
          - const: simple-mfd

  reg:
    maxItems: 1

  '#clock-cells':
    const: 1

  power-domains:
    maxItems: 1

  mediatek,hardware-voter:
    $ref: /schemas/types.yaml#/definitions/phandle
    description:
      Phandle to the hardware voter (HWV) syscon, through which the gates of
      this block are switched. See mediatek,mt8196-clock.yaml.

  reset-controller:
    type: object
    description: UFS reset lines, a ti,syscon-reset child.

required:
  - compatible
  - reg
  - '#clock-cells'

allOf:
  - if:
      properties:
        compatible:
          contains:
            const: mediatek,mt6878-mminfra-config
    then:
      required:
        - mediatek,hardware-voter
    else:
      properties:
        mediatek,hardware-voter: false

additionalProperties: false

examples:
  - |
    clock-controller@1e800000 {
        compatible = "mediatek,mt6878-mminfra-config", "syscon";
        reg = <0x1e800000 0x1000>;
        mediatek,hardware-voter = <&hwv>;
        #clock-cells = <1>;
    };
```

## Documentation/devicetree/bindings/clock/mediatek,mt6878-sys-clock.yaml
```yaml
# SPDX-License-Identifier: (GPL-2.0 OR BSD-2-Clause)
%YAML 1.2
---
$id: http://devicetree.org/schemas/clock/mediatek,mt6878-sys-clock.yaml#
$schema: http://devicetree.org/meta-schemas/core.yaml#

title: MediaTek System Clock Controller for MT6878

maintainers:
  - Igor Belwon <igor.belwon@mentallysanemainliners.org>

description: |
  The clock architecture in MediaTek SoCs is structured like below:
  PLLs -->
          dividers -->
                      muxes
                           -->
                              clock gate

  The apmixedsys, mfgpll and mfgscpll blocks provide the PLLs, generated
  from the SoC's 26 MHz crystal oscillator. The topckgen and vlpckgen
  blocks provide dividers and muxes which feed the other IP blocks.

  The clock IDs are defined in
  include/dt-bindings/clock/mediatek,mt6878-clock.h.

properties:
  compatible:
    items:
      - enum:
          - mediatek,mt6878-apmixedsys
          - mediatek,mt6878-mfgpll-pll-ctrl
          - mediatek,mt6878-mfgscpll-pll-ctrl
          - mediatek,mt6878-topckgen
          - mediatek,mt6878-vlpckgen
      - const: syscon

  reg:
    maxItems: 1

  '#clock-cells':
    const: 1

  mediatek,hardware-voter:
    $ref: /schemas/types.yaml#/definitions/phandle
    description:
      Phandle to the hardware voter (HWV) syscon, an alternative interface
      through which some of the PLLs and muxes of this block are also
      switched by other processors. See mediatek,mt8196-sys-clock.yaml.

required:
  - compatible
  - reg
  - '#clock-cells'

additionalProperties: false

examples:
  - |
    clock-controller@1000c000 {
        compatible = "mediatek,mt6878-apmixedsys", "syscon";
        reg = <0x1000c000 0x1000>;
        mediatek,hardware-voter = <&hwv>;
        #clock-cells = <1>;
    };
  - |
    clock-controller@1c012000 {
        compatible = "mediatek,mt6878-vlpckgen", "syscon";
        reg = <0x1c012000 0x1000>;
        #clock-cells = <1>;
    };
```

## Documentation/devicetree/bindings/display/mediatek/mediatek,mt6878-cmdmode-fb-kick.yaml
```yaml
# SPDX-License-Identifier: (GPL-2.0-only OR BSD-2-Clause)
%YAML 1.2
---
$id: http://devicetree.org/schemas/display/mediatek/mediatek,mt6878-cmdmode-fb-kick.yaml#
$schema: http://devicetree.org/meta-schemas/core.yaml#

title: MediaTek frame trigger for a command-mode DSI boot framebuffer

maintainers:
  - serlk <22211586+Serlk@users.noreply.github.com>

description: |
  The bootloader of some MediaTek phones sets up the display pipeline
  (OVL -> ... -> DSI) for a DSI panel in command mode and hands over a
  simple-framebuffer. In command mode the panel keeps its own frame memory,
  so framebuffer writes only become visible after the pipeline has been
  started for one frame through the DISP mutex and the DSI START register.

  This node describes the registers needed to start such frames on the
  pipeline left by the bootloader. Nothing else (timings, PLLs, panel
  supplies) is programmed. When the framebuffer's CRTC is disabled (DPMS
  off, fbdev blank) the panel gets the standard DCS commands set_display_off
  and enter_sleep_mode through the DSI command queue, and exit_sleep_mode
  and set_display_on when it is enabled again; the backlight, if given,
  is switched off and on with it. It is meant for bring-up until a full display driver exists
  and must not be used together with one for the same display.

properties:
  compatible:
    const: mediatek,mt6878-cmdmode-fb-kick

  reg:
    items:
      - description: DISP mutex
      - description: OVL feeding the DSI
      - description: DSI controller

  reg-names:
    items:
      - const: mutex
      - const: ovl
      - const: dsi

  mediatek,framebuffer:
    $ref: /schemas/types.yaml#/definitions/phandle
    description: simple-framebuffer node whose memory the OVL scans out.

  backlight:
    $ref: /schemas/types.yaml#/definitions/phandle
    description: Backlight of the panel, switched together with it.

  power-domains:
    maxItems: 1

  clocks:
    minItems: 1
    maxItems: 8

required:
  - compatible
  - reg
  - reg-names
  - mediatek,framebuffer

additionalProperties: false

examples:
  - |
    chosen {
        #address-cells = <1>;
        #size-cells = <1>;
        ranges;

        fb_main: framebuffer@fe04f000 {
            compatible = "simple-framebuffer";
            reg = <0xfe04f000 0x7e9000>;
            width = <1440>;
            height = <1440>;
            stride = <5760>;
            format = "a8r8g8b8";
        };
    };

    soc {
        #address-cells = <1>;
        #size-cells = <1>;

        display-trigger@14001000 {
            compatible = "mediatek,mt6878-cmdmode-fb-kick";
            reg = <0x14001000 0x1000>,
                  <0x14002000 0x1000>,
                  <0x1401a000 0x1000>;
            reg-names = "mutex", "ovl", "dsi";
            mediatek,framebuffer = <&fb_main>;
        };
    };
```

## Documentation/devicetree/bindings/display/panel/unihertz,titan2-main-panel.yaml
```yaml
# SPDX-License-Identifier: GPL-2.0-only OR BSD-2-Clause
%YAML 1.2
---
$id: http://devicetree.org/schemas/display/panel/unihertz,titan2-main-panel.yaml#
$schema: http://devicetree.org/meta-schemas/core.yaml#

title: Unihertz Titan 2 main display panel

maintainers:
  - serlk <22211586+Serlk@users.noreply.github.com>

description:
  The main display of the Unihertz Titan 2 smartphone, a 1440x1440 LCD
  driven over a 4-lane MIPI DSI link in command mode. The panel has its own
  frame memory and a tearing-effect output. It is powered through four
  switches, enabled in the order pm, vci, lcm, lcd.

allOf:
  - $ref: panel-common.yaml#

properties:
  compatible:
    const: unihertz,titan2-main-panel

  reg:
    maxItems: 1

  pm-supply:
    description: Main power switch of the panel module

  vci-supply:
    description: Analog supply of the panel controller

  lcm-supply:
    description: Second power switch of the panel module

  lcd-supply:
    description: Third power switch of the panel module

  touch-reset-gpios:
    maxItems: 1
    description:
      Reset of the touch controller on the panel, pulsed when the panel is
      powered up

required:
  - compatible
  - reg
  - reset-gpios
  - pm-supply
  - vci-supply
  - lcm-supply
  - lcd-supply
  - port

unevaluatedProperties: false

examples:
  - |
    #include <dt-bindings/gpio/gpio.h>

    dsi {
        #address-cells = <1>;
        #size-cells = <0>;

        panel@0 {
            compatible = "unihertz,titan2-main-panel";
            reg = <0>;

            reset-gpios = <&pio 90 GPIO_ACTIVE_LOW>;
            touch-reset-gpios = <&pio 6 GPIO_ACTIVE_LOW>;
            pm-supply = <&panel_pm>;
            vci-supply = <&panel_vci>;
            lcm-supply = <&panel_lcm>;
            lcd-supply = <&panel_lcd>;
            backlight = <&backlight>;

            port {
                panel_in: endpoint {
                    remote-endpoint = <&dsi0_out>;
                };
            };
        };
    };

...
```

## Documentation/devicetree/bindings/input/awinic,aw9523b-keypad.yaml
```yaml
# SPDX-License-Identifier: (GPL-2.0-only OR BSD-2-Clause)
%YAML 1.2
---
$id: http://devicetree.org/schemas/input/awinic,aw9523b-keypad.yaml#
$schema: http://devicetree.org/meta-schemas/core.yaml#

title: Awinic AW9523B I/O expander as a keyboard matrix scanner

maintainers:
  - serlk <22211586+Serlk@users.noreply.github.com>

description:
  The AW9523B is a 16-line I2C I/O expander. In this mode all of its lines
  belong to a keyboard matrix; the row lines are sensed (they need pull-ups)
  and the column lines are driven low one at a time while scanning. A change
  on any row line raises the expander interrupt.

allOf:
  - $ref: input.yaml#
  - $ref: matrix-keymap.yaml#

properties:
  compatible:
    const: awinic,aw9523b-keypad

  reg:
    maxItems: 1

  interrupts:
    maxItems: 1

  reset-gpios:
    maxItems: 1

  vio-supply: true

  awinic,row-lines:
    description:
      Expander lines sensing the matrix rows, in row order. Lines 0-7 are
      port 0, lines 8-15 port 1.
    $ref: /schemas/types.yaml#/definitions/uint32-array
    minItems: 1
    maxItems: 15
    items:
      maximum: 15

  awinic,column-lines:
    description: Expander lines driving the matrix columns, in column order.
    $ref: /schemas/types.yaml#/definitions/uint32-array
    minItems: 1
    maxItems: 15
    items:
      maximum: 15

  debounce-delay-ms:
    description: Delay from the interrupt to the first scan.
    default: 1

  col-scan-delay-us:
    description: Settling delay after selecting a column.
    default: 0

  poll-interval:
    description: Scan interval while any key is held, in milliseconds.
    default: 5

  label: true
  linux,keymap: true
  autorepeat: true
  wakeup-source: true

required:
  - compatible
  - reg
  - interrupts
  - awinic,row-lines
  - awinic,column-lines
  - linux,keymap

unevaluatedProperties: false

examples:
  - |
    #include <dt-bindings/gpio/gpio.h>
    #include <dt-bindings/input/input.h>
    #include <dt-bindings/interrupt-controller/irq.h>

    i2c {
        #address-cells = <1>;
        #size-cells = <0>;

        keyboard@58 {
            compatible = "awinic,aw9523b-keypad";
            reg = <0x58>;
            interrupts-extended = <&pio 12 IRQ_TYPE_LEVEL_LOW>;
            reset-gpios = <&pio 53 GPIO_ACTIVE_LOW>;
            awinic,row-lines = <0 1 2 3 4 5 6 7 8>;
            awinic,column-lines = <9 10 11 12 13 14 15>;
            linux,keymap = <MATRIX_KEY(0, 0, KEY_Y)
                            MATRIX_KEY(0, 1, KEY_T)>;
            wakeup-source;
        };
    };
```
