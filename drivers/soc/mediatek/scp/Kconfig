## drivers/soc/mediatek/scp/Kconfig
```kconfig
# SPDX-License-Identifier: GPL-2.0
# Ported to mainline 7.2 for the Unihertz Titan 2 from the MediaTek GPL
# device-modules tree (kernel_device_modules-6.1, drivers/misc/mediatek/scp).

config MTK_TINYSYS_SCP_SUPPORT
	tristate "MediaTek tinysys SCP (RV55) driver"
	depends on MTK_TINYSYS_IPI && OF_RESERVED_MEM && HAVE_ARM_SMCCC
	help
	  Driver for the MediaTek SCP (System Companion Processor) as used by
	  the downstream MT6878 kernel: mailbox/IPI channels, ready notifier,
	  awake handshake, reserved memory table and recovery. The SCP
	  firmware is loaded and set up by the boot loader; this driver only
	  releases it, as the downstream one does.
	  The module is called scp.

config MTK_TINYSYS_SCP_LOGGER_SUPPORT
	bool "SCP logger support"
	depends on MTK_TINYSYS_SCP_SUPPORT
	help
	  SCP log buffer in the SCP reserved memory, read through
	  /dev/scp and the scp sysfs attributes.

config MTK_TINYSYS_SCP_DEBUG_SUPPORT
	bool "SCP debug support"
	depends on MTK_TINYSYS_SCP_SUPPORT
	help
	  Debug attributes of the downstream SCP driver (register dumps, reset
	  by command). If unsure, say N.
```

## drivers/soc/mediatek/sensorhub/Kconfig
```kconfig
# SPDX-License-Identifier: GPL-2.0
# Ported to mainline 7.2 for the Unihertz Titan 2 from the MediaTek GPL
# device-modules tree (kernel_device_modules-6.1, drivers/misc/mediatek/sensor/2.0).

config MTK_SENSOR_SUPPORT
	tristate "MediaTek hf_manager sensor framework"
	help
	  The downstream MediaTek sensor framework core: /dev/hf_manager, the
	  character device the sensor HAL (or a daemon) uses to enable
	  sensors, set batching and read events, and /proc/hf_manager.
	  The module is called hf_manager.

config MTK_SENSORHUB
	tristate "MediaTek SCP sensor hub"
	depends on MTK_SENSOR_SUPPORT && MTK_TINYSYS_SCP_SUPPORT
	help
	  The sensor hub client of the downstream MediaTek kernel: the sensors are
	  driven by the SCP firmware, this module talks to it over the SCP
	  IPI channels and shared memory and registers them with hf_manager.
	  The module is called sensorhub.

config MTK_SENSORHUB_IIO
	tristate "IIO devices for the sensors of the MediaTek SCP sensor hub"
	depends on MTK_SENSOR_SUPPORT && IIO
	help
	  An in-kernel hf_manager client that exposes the accelerometer,
	  gyroscope, magnetometer, ambient light and proximity sensors the
	  sensor hub lists as IIO devices (hub-accel, hub-gyro, hub-magn,
	  hub-light, hub-prox), enabled at the hub while they are read.
	  For iio-sensor-proxy and other IIO clients.
	  The module is called mtk-hf-iio.
```

## drivers/soc/mediatek/vcp/Kconfig
```kconfig
# SPDX-License-Identifier: GPL-2.0-only
# Ported to mainline 7.2 for the Unihertz Titan 2 from the MediaTek GPL
# device-modules tree (kernel_device_modules-6.1, drivers/misc/mediatek/vcp).
#
# Not hooked up yet: add to drivers/soc/mediatek/Kconfig
#     source "drivers/soc/mediatek/vcp/Kconfig"
# and to drivers/soc/mediatek/Makefile
#     obj-y += vcp/

config MTK_TINYSYS_VCP_SUPPORT
	tristate "MediaTek tinysys VCP (video companion processor) driver"
	depends on ARM64 && HAVE_ARM_SMCCC
	depends on MTK_MBOX && MTK_TINYSYS_IPI
	help
	  Host side of the MT6878 VCP ("MMuP", RV55), the coprocessor that
	  runs the factory video decoder/encoder firmware and MM DVFS: mailbox
	  and IPI channels, shared memory table, power and reset through the
	  SiP call, ready handshake and the feature/notifier API used by the
	  vcodec drivers. The firmware itself is loaded by the boot loader
	  (vcp-support = <1> in the "mediatek,vcp" node).
	  The module is called mtk-vcp.
```
